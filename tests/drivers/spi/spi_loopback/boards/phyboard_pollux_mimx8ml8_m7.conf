## tests/drivers/spi/spi_loopback/boards/phyboard_pollux_mimx8ml8_m7.conf
```kconfig
#
# Copyright (C) 2025 PHYTEC Messtechnik GmbH
#
# SPDX-License-Identifier: Apache-2.0
#

CONFIG_SPI_LOOPBACK_MODE_LOOP=y
```

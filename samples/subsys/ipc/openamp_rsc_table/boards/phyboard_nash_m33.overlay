/*
 * Copyright 2024 NXP
 *
 * SPDX-License-Identifier: Apache-2.0
 */

 / {
	chosen {
		/*
		 * shared memory reserved for the inter-processor communication
		 */
		zephyr,ipc_shm = &shram;
		zephyr,ipc = &mailbox1;
	};

	shram: memory@a4000000 {
		compatible = "mmio-sram";
		reg = <0xa4000000 0x200000>;
	};
};

&mailbox1 {
	status = "okay";
};
